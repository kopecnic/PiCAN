VERSION ""

NS_ :

BS_:

BU_:

BO_ 301 Message2: 1 Vector__XXX
 SG_ counter2 : 0|4@1+ (1,0) [0|15] "" Vector__XXX

BO_ 300 Message1: 1 Vector__XXX
 SG_ counter1 : 0|4@1+ (1,0) [0|15] "" Vector__XXX

BA_DEF_ SG_  "GenSigSendType" ENUM  "Cyclic","OnWrite","OnWriteWithRepetition","OnChange","OnChangeWithRepetition","IfActive","IfActiveWithRepetition","NoSigSendType";
BA_DEF_ BO_  "GenMsgSendType" ENUM  "Cyclic","not_used","not_used","not_used","not_used","Cyclic","not_used","IfActive","NoMsgSendType";
BA_DEF_  "DBName" STRING ;
BA_DEF_  "BusType" STRING ;
BA_DEF_DEF_  "GenSigSendType" "Cyclic";
BA_DEF_DEF_  "GenMsgSendType" "NoMsgSendType";
BA_DEF_DEF_  "DBName" "";
BA_DEF_DEF_  "BusType" "CAN";
BA_ "DBName" "TeensyTestDatabase";
